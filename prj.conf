## CMakeLists.txt
```
# SPDX-License-Identifier: LicenseRef-Nordic-5-Clause

cmake_minimum_required(VERSION 3.13.1)
find_package(Zephyr REQUIRED HINTS $ENV{ZEPHYR_BASE})
project(target)


# set(dfu_common_dir ${ZEPHYR_NRF_MODULE_DIR}/samples/bluetooth/mesh/dfu/common/src)

# include_directories(${dfu_common_dir})

zephyr_library_link_libraries(MCUBOOT_BOOTUTIL)

FILE(GLOB app_sources src/*.c)

target_sources(app PRIVATE 
		${app_sources}
			)
```

## sysbuild.conf
```
# Enable MCUboot bootloader support when building with sysbuild.
SB_CONFIG_BOOTLOADER_MCUBOOT=y
```

## prj.conf
```kconfig
#
# Copyright (c) 2021 Nordic Semiconductor ASA
#
# SPDX-License-Identifier: LicenseRef-Nordic-5-Clause
#

# General configuration
CONFIG_SYSTEM_WORKQUEUE_STACK_SIZE=2048
CONFIG_FLASH=y
CONFIG_FLASH_MAP=y
CONFIG_NVS=y
CONFIG_SETTINGS=y
CONFIG_NVS_LOOKUP_CACHE=y
CONFIG_SETTINGS_NVS_NAME_CACHE=y
CONFIG_HWINFO=y



# Bootloader configuration
CONFIG_STREAM_FLASH=y
CONFIG_BOOTLOADER_MCUBOOT=y
CONFIG_IMG_MANAGER=y
CONFIG_MCUBOOT_IMG_MANAGER=y
CONFIG_MCUBOOT_GENERATE_CONFIRMED_IMAGE=y
CONFIG_MCUBOOT_IMGTOOL_SIGN_VERSION="1.0.3+0"
CONFIG_REBOOT=y

# Bluetooth configuration
CONFIG_BT=y
CONFIG_BT_DEVICE_NAME_MAX=15
CONFIG_BT_DEVICE_NAME="Tiem"
CONFIG_BT_NUS=y
CONFIG_BT_SMP=y
CONFIG_BT_NUS_AUTHEN=n
CONFIG_BT_BONDABLE=n
CONFIG_BT_RX_STACK_SIZE=2048
CONFIG_SYSTEM_WORKQUEUE_STACK_SIZE=2048
CONFIG_BT_DEVICE_APPEARANCE=833


#enable OTA via BLE
CONFIG_MCUMGR=y
CONFIG_MCUMGR_TRANSPORT_BT=y
# CONFIG_IMG_MANAGER=y
# CONFIG_STREAM_FLASH=y
CONFIG_ZCBOR=y
CONFIG_MCUMGR_GRP_IMG=y
CONFIG_MCUMGR_GRP_OS=y
CONFIG_MCUMGR_GRP_ZBASIC=y
CONFIG_MCUMGR_GRP_ZBASIC_STORAGE_ERASE=y
CONFIG_MCUMGR_TRANSPORT_BT_PERM_RW=y
CONFIG_MCUMGR_TRANSPORT_NETBUF_COUNT=6
CONFIG_MCUMGR_MGMT_NOTIFICATION_HOOKS=y
CONFIG_MCUMGR_GRP_IMG_UPLOAD_CHECK_HOOK=y
CONFIG_MCUMGR_SMP_COMMAND_STATUS_HOOKS=y
CONFIG_BT_L2CAP_TX_MTU=498
CONFIG_BT_BUF_ACL_RX_SIZE=502
CONFIG_MCUMGR_TRANSPORT_NETBUF_SIZE=1024
CONFIG_SYSTEM_WORKQUEUE_STACK_SIZE=2800
CONFIG_MCUMGR_TRANSPORT_BT_CONN_PARAM_CONTROL=y
CONFIG_MCUMGR_GRP_OS_BOOTLOADER_INFO=y
CONFIG_MCUMGR_TRANSPORT_BT_REASSEMBLY=y 
CONFIG_NCS_SAMPLE_MCUMGR_BT_OTA_DFU_SPEEDUP=y 

CONFIG_BT_PERIPHERAL=y
CONFIG_BT_PERIPHERAL_PREF_MIN_INT=36
CONFIG_BT_PERIPHERAL_PREF_MAX_INT=36
CONFIG_BT_PERIPHERAL_PREF_TIMEOUT=500
CONFIG_BT_GAP_AUTO_UPDATE_CONN_PARAMS=y
CONFIG_BT_CONN_PARAM_UPDATE_TIMEOUT=1000
CONFIG_BT_GATT_DYNAMIC_DB=y
CONFIG_BT_DEVICE_NAME_DYNAMIC=y
CONFIG_BT_DEVICE_NAME_MAX=15
CONFIG_BT_MAX_CONN=1
CONFIG_BT_BUF_ACL_TX_SIZE=251
CONFIG_BT_CTLR_DATA_LENGTH_MAX=251

# CONFIG_BT_COMPANY_ID_NORDIC=0x0059
CONFIG_BT_COMPANY_ID=0x0059
# CONFIG_BT_LL_SOFTDEVICE_HEADERS_INCLUDE=y
CONFIG_BT_LL_SOFTDEVICE=y

CONFIG_BT_LL_SOFTDEVICE_BUILD_TYPE_LIB=y
CONFIG_BT_HCI_TX_STACK_SIZE=1536

CONFIG_BT_CTLR_SDC_PERIPHERAL_COUNT=1
CONFIG_BT_CTLR_SDC_MAX_CONN_EVENT_LEN_DEFAULT=7500
# CONFIG_BT_CTLR_SDC_CENTRAL_ACL_EVENT_SPACING_DEFAULT=7500

CONFIG_BT_CTLR_SDC_TX_PACKET_COUNT=3
CONFIG_BT_CTLR_SDC_RX_PACKET_COUNT=2
CONFIG_BT_CTLR_SDC_PERIODIC_SYNC_BUFFER_COUNT=3
# CONFIG_BT_CTLR_SDC_RX_PRIO=6
CONFIG_BT_CTLR_FAL_SIZE=8
CONFIG_BT_LL_SOFTDEVICE_PERIPHERAL=y
# CONFIG_BT_CTLR_SDC_BIG_RESERVED_TIME_US=1600
# CONFIG_BT_CTLR_SDC_CIG_RESERVED_TIME_US=1300
# CONFIG_BT_CTLR_SDC_CIS_SUBEVENT_LENGTH_US=0
# CONFIG_BT_NRF_SERVICES=y
CONFIG_BT_GATT_AUTO_SEC_REQ=y
CONFIG_BT_BROADCASTER=y
# CONFIG_BT_CONN=y
CONFIG_BT_PHY_UPDATE=y
CONFIG_BT_DATA_LEN_UPDATE=y
CONFIG_BT_BUF_ACL_TX_COUNT=3
CONFIG_BT_BUF_ACL_RX_COUNT_EXTRA=5
CONFIG_BT_BUF_EVT_RX_SIZE=68
CONFIG_BT_BUF_EVT_RX_COUNT=10
CONFIG_BT_BUF_EVT_DISCARDABLE_SIZE=43
CONFIG_BT_BUF_EVT_DISCARDABLE_COUNT=3
CONFIG_BT_BUF_CMD_TX_SIZE=65
# CONFIG_BT_HAS_HCI_VS=y
CONFIG_BT_HCI_VS=y
# CONFIG_BT_RPA=y
CONFIG_BT_ASSERT=y
CONFIG_BT_ASSERT_VERBOSE=y
CONFIG_BT_DEBUG_MONITOR_RTT=y
CONFIG_BT_DEBUG_MONITOR_RTT_BUFFER=1
CONFIG_BT_DEBUG_MONITOR_RTT_BUFFER_NAME="btmonitor"
CONFIG_BT_DEBUG_MONITOR_RTT_BUFFER_SIZE=1024
CONFIG_BT_LONG_WQ=y
# CONFIG_BT_LONG_WQ_STACK_SIZE=1140
CONFIG_BT_LONG_WQ_PRIO=10
CONFIG_BT_LONG_WQ_INIT_PRIO=50
# CONFIG_BT_HCI_HOST=y
# CONFIG_BT_HCI_TX_PRIO=7
# CONFIG_BT_HCI_RESERVE=0
CONFIG_BT_RECV_WORKQ_BT=y
# CONFIG_BT_RX_PRIO=8
# CONFIG_BT_DRIVER_RX_HIGH_PRIO=6
CONFIG_BT_LIM_ADV_TIMEOUT=30
# CONFIG_BT_CONN_TX_USER_DATA_SIZE=8
CONFIG_BT_CONN_TX_MAX=3
CONFIG_BT_AUTO_PHY_PERIPHERAL_2M=y
# CONFIG_BT_USER_DATA_LEN_UPDATE is not set
CONFIG_BT_AUTO_DATA_LEN_UPDATE=y
# CONFIG_BT_REMOTE_INFO is not set
# CONFIG_BT_SMP_ENFORCE_MITM is not set
# CONFIG_BT_KEYS_OVERWRITE_OLDEST is not set
CONFIG_BT_SMP_MIN_ENC_KEY_SIZE=7
CONFIG_BT_L2CAP_TX_BUF_COUNT=3
CONFIG_BT_L2CAP_TX_FRAG_COUNT=2
# CONFIG_BT_L2CAP_RESCHED_MS=1000
CONFIG_BT_ATT_PREPARE_COUNT=0
CONFIG_BT_ATT_RETRY_ON_SEC_ERR=y
CONFIG_BT_GATT_SERVICE_CHANGED=y
CONFIG_BT_GATT_ENFORCE_SUBSCRIPTION=y
CONFIG_BT_GATT_READ_MULTIPLE=y
CONFIG_BT_GATT_READ_MULT_VAR_LEN=y
CONFIG_BT_GAP_PERIPHERAL_PREF_PARAMS=y
CONFIG_BT_PERIPHERAL_PREF_LATENCY=0
CONFIG_BT_MAX_PAIRED=1
CONFIG_BT_CREATE_CONN_TIMEOUT=3
CONFIG_BT_CONN_PARAM_RETRY_COUNT=3
CONFIG_BT_CONN_PARAM_RETRY_TIMEOUT=5000
CONFIG_BT_ID_MAX=1
# CONFIG_BT_CRYPTO=y
CONFIG_DFU_MULTI_IMAGE=y
CONFIG_DFU_TARGET=y
# CONFIG_DFU_TARGET_MCUBOOT=y
# CONFIG_DFU_TARGET_STREAM=y
# CONFIG_DFU_TARGET_LOG_LEVEL_DEFAULT=y
# CONFIG_DFU_TARGET_LOG_LEVEL=1
# # CONFIG_PCD_VERSION_PAGE_BUF_SIZE=2046
# CONFIG_BLE_HCI_VSC_LOG_LEVEL_DEFAULT=y
# CONFIG_BLE_HCI_VSC_LOG_LEVEL=1


#log 
CONFIG_USE_SEGGER_RTT=y
CONFIG_BT_DEBUG_MONITOR_RTT=y
CONFIG_PRINTK=y
CONFIG_CONSOLE=y
CONFIG_UART_CONSOLE=n
CONFIG_RTT_CONSOLE=y
CONFIG_LOG=y
CONFIG_LOG_BACKEND_UART=n
```

## src/main.c
```c
/*
 * Copyright (c) 2021 Nordic Semiconductor ASA
 *
 * SPDX-License-Identifier: LicenseRef-Nordic-5-Clause
 */

/** @file
 *  @brief Bluetooth Mesh DFU Target role sample
 */

#include <zephyr/kernel.h>
#include <zephyr/logging/log.h>
#include <bluetooth/services/nus.h>
#include <zephyr/bluetooth/bluetooth.h>
#include <zephyr/bluetooth/conn.h>
#include <stdint.h>

///////////////////////////////NUS Service /////////////////////////
#define DOOR_STATE_SERVICE 0x0002
#define DOOR_STATE_SERVICE_LEN 10

#define GDO_NAME 6

const uint32_t kAdvertisingOptions = BT_LE_ADV_OPT_CONN;
const uint8_t kAdvertisingFlags = BT_LE_AD_GENERAL | BT_LE_AD_NO_BREDR;
const uint8_t kBTUuid[] = {BT_UUID_NUS_VAL};
const uint16_t kAdvertisingIntervalMin = 100;
const uint16_t kAdvertisingIntervalMax = 150;

static volatile bool isConnected = false;

struct bt_data mAdvertisingItems[2];
struct bt_data serviceData;

// static struct bt_conn_auth_cb sConnAuthCallbacks;
// static struct bt_conn_auth_info_cb sConnAuthInfoCallbacks;
static struct bt_nus_cb sNusCallbacks;

uint8_t BLEName[GDO_NAME];

static struct bt_conn *mBTConnection;

void RxCallback(struct bt_conn *conn, const uint8_t *const data, uint16_t len)
{
	printk("receive %s\n",data); 
}

void TxCallback(struct bt_conn *conn)
{
	//   GetBLESCConnection().SendMsgCallback(BLE_SEND_SUCCESS);
}

// int  Disconnect()
// {
//   int ret = 0;
//   if (GetGDONUSService().mBTConnection != NULL) {
//     ret = bt_conn_disconnect(GetGDONUSService().mBTConnection, BT_HCI_ERR_UNACCEPT_CONN_PARAM);
//     if (ret != 0) {
//       LOG_ERR("<BLE> Can't disconnect! code %d\n", ret);
//     }
//   } else {
//     LOG_ERR("<BLE> BLE is not yet connected\n");
//     ret = -1;
//   }
//   return ret;
// }

bool SendData(const char *const data, size_t length)
{

	if (bt_nus_send(mBTConnection, (uint8_t *)(data), length) != 0)
		return false;

	return true;
}

void Connected(struct bt_conn *conn, uint8_t err)
{
	if (err || !conn)
	{
		printk("<BLE> BLE Connection failed (err %u)\n", err);
		return;
	}
	if (!isConnected)
	{

		printk("connected\n");
		mBTConnection = conn;
		bt_conn_set_security(conn, BT_SECURITY_L1);

		isConnected = true;
	}
}

void Disconnected(struct bt_conn *conn, uint8_t reason)
{
	mBTConnection = NULL;
	isConnected = false;
	printk("Disconnected\n");
}

void PairingFailed(struct bt_conn *conn, enum bt_security_err reason)
{
	// printk("<BLE> BT Pairing failed to %s : reason %d\n", LogAddress(conn), (uint8_t)(reason));
}

static struct bt_conn_cb conn_callbacks = {
	.connected = Connected,
	.disconnected = Disconnected,
};

static struct bt_nus_cb sNusCallbacks = {
	.received = RxCallback,
	.sent = TxCallback,
};


// static const struct bt_data ad[] = {
// 	BT_DATA_BYTES(BT_DATA_FLAGS, kAdvertisingFlags),
// 	// BT_DATA_BYTES(BT_DATA_NAME_COMPLETE,"Tiem"),
// };


void startNUS()
{
	uint8_t BLENameLen = strlen(bt_get_name());
	memcpy(BLEName, bt_get_name(), BLENameLen);
	mAdvertisingItems[0]= (struct bt_data){
		.type = BT_DATA_FLAGS,
		.data_len = sizeof(kAdvertisingFlags),
		.data = &kAdvertisingFlags,
	} ;

	mAdvertisingItems[1].type = BT_DATA_NAME_COMPLETE;
	mAdvertisingItems[1].data_len = BLENameLen;
	mAdvertisingItems[1].data = BLEName;

	serviceData =  (struct bt_data)BT_DATA(BT_DATA_UUID128_ALL, kBTUuid, sizeof(kBTUuid));

	int ret;
	bt_conn_cb_register(&conn_callbacks);

	ret = bt_nus_init(&sNusCallbacks);
	if (ret != 0)
	{
		printk("<BLE> BLE init fail, error code: %d\n", ret);
		return;
	}

	struct bt_le_adv_param params = BT_LE_ADV_PARAM_INIT(kAdvertisingOptions, kAdvertisingIntervalMin, kAdvertisingIntervalMax, NULL);
	// params.id = sBtId;
	const int result = bt_le_adv_start(&params, mAdvertisingItems, ARRAY_SIZE(mAdvertisingItems), &serviceData,
									   1);
	// const int result = bt_le_adv_start(&params, ad, ARRAY_SIZE(ad), &serviceData,
	// 								   sizeof(serviceData));

	if (result != 0)
	{
		printk("Start ADV error");
	}
}

int main(void)
{

	printk("Run main app version 1.0.3\n");
	int err;

	err = bt_enable(NULL);
	if (err)
	{
		printk("Bluetooth init failed (err %d)\n", err);
		return 0;
	}

	startNUS();

	while (1)
	{
		k_sleep(K_MSEC(1000));
	}

	return 0;
}
```
